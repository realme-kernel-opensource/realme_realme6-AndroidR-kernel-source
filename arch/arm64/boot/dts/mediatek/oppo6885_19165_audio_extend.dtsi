//#ifdef OPLUS_ARCH_EXTENDS
&audio_extend {
	//for nxp speaker
	oplus,speaker-vendor = "nxp";
	oplus,speaker-i2s-id = <3>;
	oplus,speaker-i2s-id-in = <0>;
	oplus,speaker-codec-name = "tfa98xx.6-0035";
	oplus,speaker-codec-dai-name = "tfa98xx-aif-6-35";
};

&i2c6 {
	tfa98xx: tfa98xx@35 {
		compatible = "nxp,tfa98xx";
		reg = <0x35>;
		//reset-gpio = <&pio 111 0>;
		status = "okay";
	};
};


//#endif /*OPLUS_ARCH_EXTENDS*/
