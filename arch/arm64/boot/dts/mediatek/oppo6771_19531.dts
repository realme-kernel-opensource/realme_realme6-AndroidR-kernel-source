/*
 * Mediatek's mt6771 SoC device tree source
 *
 * Copyright (C) 2016 MediaTek Inc.
 *
 * This program is free software; you can redistribute it and/or modify
 * it under the terms of the GNU General Public License version 2 as
 * published by the Free Software Foundation.
 *
 * This program is distributed in the hope that it will be useful,
 * but WITHOUT ANY WARRANTY; without even the implied warranty of
 * MERCHANTABILITY or FITNESS FOR A PARTICULAR PURPOSE.
 * See http://www.gnu.org/licenses/gpl-2.0.html for more details.
 */
/dts-v1/;
/plugin/;
#include <dt-bindings/interrupt-controller/irq.h>
#include <dt-bindings/interrupt-controller/arm-gic.h>
#include <dt-bindings/pinctrl/mt6771-pinfunc.h>

/* chosen */
&chosen {
	/* fpga may has no lk, we need to specify display info here */
	/* fb buffer is reserved using this dts by memory node above */

	atag,videolfb-fb_base_l = <0x5e605000>;
	atag,videolfb-fb_base_h = <0x0>;
	atag,videolfb-islcmfound = <1>;
	atag,videolfb-islcm_inited = <0>;
	atag,videolfb-fps= <6000>;
	atag,videolfb-vramSize= <0x017bb000>;
	atag,videolfb-lcmname= "nt35595_fhd_dsi_cmd_truly_nt50358_drv";
};

&odm {
//#ifdef VENDOR_EDIT
#include "mediatek/bat_setting/oppo_17197_mt6771_battery_prop_ext.dtsi"
//endif
	led0:led@0 {
		compatible = "mediatek,red";
		led_mode = <0>;
		data = <1>;
		pwm_config = <0 0 0 0 0>;
	};
	led1:led@1 {
		compatible = "mediatek,green";
		led_mode = <0>;
		data = <1>;
		pwm_config = <0 0 0 0 0>;
	};
	led2:led@2 {
		compatible = "mediatek,blue";
		led_mode = <0>;
		data = <1>;
		pwm_config = <0 0 0 0 0>;
	};
	led3:led@3 {
		compatible = "mediatek,jogball-backlight";
		led_mode = <0>;
		data = <1>;
		pwm_config = <0 0 0 0 0>;
	};
	led4:led@4 {
		compatible = "mediatek,keyboard-backlight";
		led_mode = <0>;
		data = <1>;
		pwm_config = <0 0 0 0 0>;
	};
	led5:led@5 {
		compatible = "mediatek,button-backlight";
		led_mode = <0>;
		data = <1>;
		pwm_config = <0 0 0 0 0>;
	};
	led6:led@6 {
		compatible = "mediatek,lcd-backlight";
		/* #ifndef OPLUS_BUG_STABILITY */
		/* led_mode = <5>; */
		/* #else OPLUS_BUG_STABILITY */
		led_mode = <4>;
		/* #endif OPLUS_BUG_STABILITY */
		data = <1>;
		pwm_config = <0 1 0 0 0>;
	};
	vibrator0:vibrator@0 {
		compatible = "mediatek,vibrator";
		vib_timer = <30>;
		vib_limit = <0>;
//#ifndef VENDOR_EDIT
		//vib_vol= <9>;
//#else
		vib_vol= <11>;
//#endif /* VENDOR_EDIT */
	};
/* sensor start */
	/*
	enum {
		LIS3DH,
		LSM6DS3,
		BMI160,
		LIS2HH12,
		LSM6DSM,
		BMI2XY,
	};
	*/
	gsensor_1: gsensor_1 {
		status = "okay";
		sensor_name = <2>;//BMI160
		i2c_num = <1>;
		i2c_addr = <0x68>;
		direction = <5>;
		eint_num = <4>;
		step_count_7_en = <0>;
		config_miso = <0>;
		correct_y_bias = <0>;
	};
	gsensor_2: gsensor_2 {
		status = "okay";
		sensor_name = <4>;//LSM6DSM
		i2c_num = <1>;
		i2c_addr = <0x68>;
		direction = <4>;
		eint_num = <4>;
        };
	/*
	enum {
		AKM09911,
		MMC3530,
		MMC5603,
		MXG4300,
	};
	*/
	msensor_1: msensor_1 {
		status = "okay";
		sensor_name = <0>;//AKM09911
		i2c_num = <1>;
		i2c_addr = <0x0c>;
		direction = <3>;
		eint_num = <0>;
		libname = "akm";
		soft-mag-parameter = <216 82 227 38 160 178 1 191 209 54 219 101 137 196 254 119 254 253 41 236 187 249 70 97 13 255 155>;
	};
	msensor_2: msensor_2 {
		status = "okay";
		sensor_name = <2>;//MMC5603
		i2c_num = <1>;
		i2c_addr = <0x30>;
		direction = <3>;
		eint_num = <0>;
        };
	/*
	enum {
		TMD2725,
		APSD9922,
		STK3335,
		STK3331,
		STK2232,
		TCS3701,
		STK32600,
	};
	*/
        proximity_1: proximity_1 {
                status = "okay";
                sensor_name = <4>;//STK2232
                i2c_num = <1>; 
                i2c_addr = <0x57>;
                direction = <4>; 
                eint_num = <7>;
                ps_type =<0>;//0 means underscreen;1 means normal;2 means double;
                screen_struct=<1>;//different screen means different sensor paremeter;1 means 19531/19301/19011
        }; 
	light_1: light_1 {
		status = "okay";
		sensor_name = <4>;//STK2232
		i2c_num = <1>;
		i2c_addr = <0x57>;
		direction = <4>;
		eint_num = <7>;
		als_type = <0>;//0 means underscreen;1 means normal;
	};
	pick_up: pick_up {
		status = "okay";
		use-proximity = <0>;
	};
	lux_aod: lux_aod {
		status = "okay";
		use-proximity = <1>;
	};
	alsps_arch: alsps_arch {
		status = "okay";
		new-arch-supported = <0>;
	};
/* sensor end */
	usb_c_pinctrl:usb_c_pinctrl {
		compatible = "mediatek,usb_c_pinctrl";
	};

       kpd_volume_up:kpd_volume_up {
               compatible = "mediatek, VOLUME_UP-eint";
               interrupt-parent = <&pio>;
               interrupts = <20 IRQ_TYPE_EDGE_FALLING 20 0>;
               debounce = <32000>;
               status = "okay";
       };

       kpd_volume_down:kpd_volume_down {
               compatible = "mediatek, VOLUME_DOWN-eint";
               interrupt-parent = <&pio>;
               interrupts = <94 IRQ_TYPE_EDGE_FALLING 94 0>;
               debounce = <32000>;
               status = "okay";
       };
//#endif
	//#ifdef VENDOR_EDIT
	vooc_ap_data:vooc_ap_data {
		compatible = "mediatek, VOOC_AP_DATA-eint";
		interrupts = <26 IRQ_TYPE_EDGE_FALLING 26 0>;
	};
	vooc_ap_data_new_function:vooc_ap_data_new_function {
		compatible = "mediatek, VOOC_EINT_NEW_FUNCTION";
	};
	//#endif /*VENDOR_EDIT*/

	oplus_charger: oplus_charger {
		compatible = "mediatek,oplus-charger";
		pinctrl-names = "default", "charger_gpio_as_output_low", "charger_gpio_as_output_high",
				"ship_sleep", "ship_active", "dischg_enable", "dischg_disable";
		pinctrl-0 = <&charger_pins_default>;
		pinctrl-1 = <&charger_pins_eint_output0>;
		pinctrl-2 = <&charger_pins_eint_output1>;
		pinctrl-3 = <&ship_sleep_gpio>;
		pinctrl-4 = <&ship_active_gpio>;
		pinctrl-5 = <&dischg_enable>;
		pinctrl-6 = <&dischg_disable>;
		//pinctrl-5 = <&shortc_active_gpio>;

		//for oplus chg framework:
		qcom,pd_input_current_charger_ma = <2000>;
		qcom,input_current_charger_ma = <2000>;
		qcom,input_current_cdp_ma = <1500>;
		qcom,input_current_usb_ma = <500>;
		qcom,input_current_led_ma = <1200>;
		qcom,input_current_led_ma_forcmcc = <500>;
		qcom,input_current_camera_ma = <1200>;
		qcom,input_current_calling_ma = <1500>;
		qcom,input_current_led_ma_high = <1200>;
		qcom,input_current_led_ma_warm = <1500>;
		qcom,input_current_led_ma_normal = <2000>;
		qcom,led_warm_bat_decidegc = <350>;
		qcom,led_high_bat_decidegc = <370>;

		qcom,iterm_disabled = <0>;
		qcom,iterm_ma = <205>;
		qcom,recharge-mv = <115>;

		qcom,batt_capacity_mah = <4000>; /*typical capacity*/
		//qcom,batt_capacity_mah = <3900>; /*rated capacity*/

		qcom,removed_bat_decidegc = <190>;  /* < -19C */

		qcom,cold_bat_decidegc = <20>;  /* -3C ~ 0C */
		qcom,temp_cold_vfloat_mv = <3980>;
		qcom,temp_cold_fastchg_current_ma = <360>;

		qcom,little_cold_bat_decidegc = <0>;	/* 0C ~ 5C */
		qcom,temp_little_cold_vfloat_mv = <4385>;
		qcom,temp_little_cold_fastchg_current_ma_high = <1850>;
		qcom,temp_little_cold_fastchg_current_ma_low = <1100>;
		qcom,temp_little_cold_fastchg_current_ma = <1100>;
		qcom,pd_temp_little_cold_fastchg_current_ma_high = <1850>;
		qcom,pd_temp_little_cold_fastchg_current_ma_low = <1100>;

		qcom,cool_bat_decidegc = <50>;	/* 5C ~ 12C */
		qcom,temp_cool_vfloat_mv = <4385>;
		qcom,temp_cool_fastchg_current_ma_high = <2200>;
		qcom,temp_cool_fastchg_current_ma_low = <1850>;
		qcom,pd_temp_cool_fastchg_current_ma_high = <2550>;
		qcom,pd_temp_cool_fastchg_current_ma_low = <1850>;

		qcom,little_cool_bat_decidegc = <120>;	/* 12C ~ 16C */
		qcom,temp_little_cool_vfloat_mv = <4385>;
		qcom,temp_little_cool_fastchg_current_ma = <2200>;
		qcom,pd_temp_little_cool_fastchg_current_ma = <3300>;

		qcom,normal_bat_decidegc = <160>;	/* 16C ~ 45C */
		qcom,temp_normal_vfloat_mv = <4385>;
		qcom,temp_normal_fastchg_current_ma = <2200>;
		qcom,pd_temp_normal_fastchg_current_ma = <3300>;

		qcom,warm_bat_decidegc = <450>;		/* 45C ~ 53C */ /*8pin Bat Vooc project need add 3 degree C*/
		qcom,temp_warm_vfloat_mv = <4130>;
		qcom,temp_warm_fastchg_current_ma = <1100>;
		qcom,temp_warm_fastchg_current_ma_led_on = <500>;
		qcom,pd_temp_warm_fastchg_current_ma = <1100>;

		qcom,hot_bat_decidegc = <530>;  /* > 53C */

		qcom,non_standard_vfloat_mv = <3980>;
		qcom,non_standard_fastchg_current_ma = <512>;

		qcom,short_c_bat_cv_mv = <4330>;
		qcom,short_c_bat_vfloat_mv = <3800>;
		qcom,short_c_bat_fastchg_current_ma = <512>;
		qcom,short_c_bat_vfloat_sw_limit = <3750>;

		qcom,cold_vfloat_sw_limit = <3930>;
		qcom,little_cold_vfloat_sw_limit = <4335>;
		qcom,cool_vfloat_sw_limit = <4335>;
		qcom,little_cool_vfloat_sw_limit = <4335>;
		qcom,normal_vfloat_sw_limit = <4335>;
		qcom,warm_vfloat_sw_limit = <4080>;
		qcom,non_standard_vfloat_sw_limit = <3930>;

		qcom,max_chg_time_sec = <36000>;
		qcom,charger_hv_thr = <5800>;
		qcom,charger_lv_thr = <3400>;
		qcom,vbatt_full_thr = <4400>;
		qcom,vbatt_hv_thr = <4500>;

		qcom,vfloat_step_mv = <10>;
		qcom,non_standard_vfloat_over_sw_limit = <3980>;
		qcom,cold_vfloat_over_sw_limit = <3980>;
		qcom,little_cold_vfloat_over_sw_limit = <4390>;
		qcom,cool_vfloat_over_sw_limit = <4390>;
		qcom,little_cool_vfloat_over_sw_limit = <4390>;
		qcom,normal_vfloat_over_sw_limit = <4390>;
		qcom,warm_vfloat_over_sw_limit = <4130>;

		qcom,vbatt_power_off = <3300>;
		qcom,vbatt_soc_1 = <3410>;
		qcom,vooc_project = <1>;
		qcom,vbatt_num = <1>;

		qcom,normal_vterm_hw_inc = <150>;
		qcom,non_normal_vterm_hw_inc = <10>;

		qcom,ff1_normal_fastchg_ma = <1200>;
		qcom,ff1_warm_fastchg_ma = <1200>;
		qcom,ffc2_normal_fastchg_ma = <700>;/*12C~35c*/
		qcom,ffc2_warm_fastchg_ma = <800>;/*35C~40c*/
		qcom,ffc2_temp_warm_decidegc = <350>;
		qcom,ffc2_temp_high_decidegc = <400>;
		qcom,ffc2_temp_low_decidegc = <120>;
		qcom,ff1_exit_step_ma = <680>;
		qcom,ff1_warm_exit_step_ma = <630>;
		qcom,ffc2_exit_step_ma = <180>;
		qcom,ffc2_warm_exit_step_ma = <230>;

		qcom,ffc_normal_vfloat_sw_limit = <4430>;
		qcom,ffc2_normal_vfloat_sw_limit = <4430>;
		qcom,ffc_temp_normal_vfloat_mv = <4500>;
		qcom,ffc_normal_vfloat_over_sw_limit = <4500>;

		qcom,default_iterm_ma = <205>;
		qcom,default_temp_normal_fastchg_current_ma = <2200>;
		qcom,default_normal_vfloat_sw_limit = <4335>;
		qcom,default_temp_normal_vfloat_mv = <4385>;
		qcom,default_normal_vfloat_over_sw_limit = <4390>;

		//for 2nd chip:
		qcom,iterm_ma_2nd = <300>;
		qcom,recharge-mv_2nd = <121>;

		qcom,temp_little_cold_vfloat_mv_2nd = <4391>;	/* 0C ~ 5C */
		qcom,temp_cool_vfloat_mv_2nd = <4391>;	/* 5C ~ 12C */
		qcom,temp_little_cool_vfloat_mv_2nd = <4391>;	/* 12C ~ 16C */
		qcom,temp_normal_vfloat_mv_2nd = <4391>;	/* 16C ~ 45C */

		qcom,little_cold_vfloat_over_sw_limit_2nd = <4395>;
		qcom,cool_vfloat_over_sw_limit_2nd = <4395>;
		qcom,little_cool_vfloat_over_sw_limit_2nd = <4395>;
		qcom,normal_vfloat_over_sw_limit_2nd = <4395>;

		qcom,default_iterm_ma_2nd = <300>;
		qcom,default_temp_normal_vfloat_mv_2nd = <4391>;
		qcom,default_normal_vfloat_over_sw_limit_2nd = <4395>;

		//for control:
		//qcom,suspend_after_full;
		qcom,check_batt_full_by_sw;
		qcom,external_gauge;
		qcom,chg_ctrl_by_calling;
		qcom,chg_ctrl_by_lcd;
		qcom,chg_ctrl_by_camera;
		qcom,sw_vfloat_over_protect_enable;
		qcom,ffc_support;

		//GPIO config:
		qcom,chargerid_switch-gpio = <&pio 97 0x00>;
		qcom,ship-gpio = <&pio 155 0x00>;
		qcom,dischg-gpio = <&pio 17 0x00>;
		//qcom,shortc-gpio = <&pio 77 0x00>;
	};

//#ifdef VENDOR_EDIT
	fuelgauge: fuelgauge {
		compatible = "mediatek, fuelgauge";
	};
//#endif

        flashlights_mt6370: flashlights_mt6370 {
                compatible = "mediatek,flashlights_mt6370";
                decouple = <0>;
                channel@1 {
                        type = <0>;
                        ct = <0>;
                        part = <0>;
                };
                channel@2 {
                        type = <0>;
                        ct = <1>;
                        part = <0>;
                };
        };
	oplus_project:oplus_project {
		compatible = "oppo,oplus_project";
	};
	oplus_devinfo:oplus_devinfo {
		compatible = "oppo-devinfo";

		main-sub {
			compatible = "hw-match, main-sub";
			aboard-patterns = <0 0 0>;
			/*main board*/
			match-projects = <19531 19532 19533>;
		};
	};
};
&oplus_devinfo {
	aboard-gpio0 = <&pio 58 0x00>;
	aboard-gpio1 = <&pio 157 0x00>;
	aboard-gpio2 = <&pio 18 0x00>;
	aboard-gpio3 = <&pio 80 0x00>;
	aboard-gpio4 = <&pio 22 0x00>;
	pinctrl-names = "default", "aboard_gpio0_sleep", "aboard_gpio0_active",
			"aboard_gpio1_sleep", "aboard_gpio1_active",
			"aboard_gpio2_active","aboard_gpio3_active","aboard_gpio4_active";
	pinctrl-0 = <&hw_pins_default>;
	pinctrl-1 = <&aboard_pin_gpio0_sleep>;
	pinctrl-2 = <&aboard_pin_gpio0_active>;
	pinctrl-3 = <&aboard_pin_gpio1_sleep>;
	pinctrl-4 = <&aboard_pin_gpio1_active>;
	pinctrl-5 = <&aboard_pin_gpio2_active>;
	pinctrl-6 = <&aboard_pin_gpio3_active>;
	pinctrl-7 = <&aboard_pin_gpio4_active>;
};
&pio {
	hw_pins_default:default@hw_sub_id {
	};

	aboard_pin_gpio0_sleep:sleep@id0 {
		pins_cmd_dat {
			pinmux = <PINMUX_GPIO58__FUNC_GPIO58>;
			input;
			bias-disable;
			input-enable;
		};
	};

	aboard_pin_gpio0_active:active@id0 {
		pins_cmd_dat {
			pinmux = <PINMUX_GPIO58__FUNC_GPIO58>;
			input;
			bias-disable;
			input-enable;
		};
	};

	aboard_pin_gpio1_sleep:sleep@id1 {
		pins_cmd_dat {
			pinmux = <PINMUX_GPIO157__FUNC_GPIO157>;
			input;
			bias-disable;
			input-enable;
		};
	};

	aboard_pin_gpio1_active:active@id1 {
		pins_cmd_dat {
			pinmux = <PINMUX_GPIO157__FUNC_GPIO157>;
			input;
			bias-disable;
			input-enable;
		};
	};
	aboard_pin_gpio2_active:active@id2 {
		pins_cmd_dat {
			pinmux = <PINMUX_GPIO18__FUNC_GPIO18>;
			input;
			bias-pull-down;
			input-enable;
		};
	};
	aboard_pin_gpio3_active:active@id3 {
		pins_cmd_dat {
			pinmux = <PINMUX_GPIO80__FUNC_GPIO80>;
			input;
			bias-pull-down;
			input-enable;
		};
	};
	aboard_pin_gpio4_active:active@id4 {
		pins_cmd_dat {
			pinmux = <PINMUX_GPIO22__FUNC_GPIO22>;
			input;
			bias-pull-down;
			input-enable;
		};
	};
};
&scp {
	core_1 = "enable";
	scp_sramSize = <0x00080000>;     /* scp_A_sram_size */
};

//#ifdef OPLUS_FEATURE_TP_BASIC
&i2c0 {
	status = "okay";
	synaptics19531@20 {
		compatible = "synaptics-s3706";
		reg = <0x20>;
		chip-name = "S3706";

		/* Interrupt && Irq-gpio */
		//interrupt-parent = <&tlmm>;
		//interrupts = <1 0x2008>;
		interrupt-parent = <&pio>;
		interrupts = <1 IRQ_TYPE_LEVEL_LOW 1 0>;

		/* Power Config */
		enable2v8_gpio = <&pio 159 0x1>;
		//vdd_2v8-supply = <&mt_pmic_vmch_ldo_reg>;
		//vcc_1v8-supply = <&pm660_l14>;
		//vdd_2v8_volt = <2950000>;

		vid_len = <2>;
		tp_type = <8>; /*type:8 SAMSUNG*/
		platform_support_project = <19531>;
		platform_support_project_dir = <19531>;
		platform_support_project_commandline = "default_commandline";
		/* Other HW Resource */
		//irq-gpio = <&tlmm 1 0x2008>;
		irq-gpio = <&pio 1 0x2008>;
		//reset-gpio = <&tlmm 58 0x1>;
		reset-gpio = <&pio 150 0>;
		pinctrl-names = "default";
		//pinctrl-0 = <&ts_int_active &ts_reset_active>;

		touchpanel,max-num-support = <10>;
		touchpanel,tx-rx-num = <16 34>;
		touchpanel,panel-coords = <1080 2340>;
		touchpanel,display-coords = <1080 2340>;
		touchpanel,touchmajor-limit = <0 54>;

		/* SW Support Feature Control */
		black_gesture_support;
		fw_edge_limit_support;
		fw_corner_limit_support;
		pressure_report_support;
		//spurious_fingerprint_support;
		charger_pump_support;
		game_switch_support;
		face_detect_support;
		smart_gesture_support;
		fw_update_app_support;
		fingerprint_underscreen_support;
		report_120hz_support;
		report_point_first_support;
		/*
		 *Virtual Key Config:
		 *1:touchpanel,button-type: <virtualkey_type  supportted_button-map>
		 *virtualkey_type:
		 *Type 1: using board_properties
		 *Type 2: using same IC (button zone&& touch zone are seprate)
		 *Type 3: using diffrent IC (button zone&& touch zone are seprate)
		 *Type 4: No need of virtual key process
		 *supportted_button-map:select|menu|home|back
		 *
		 *2:touchpanel,button-map
		 *type (X1,Y1)(X2,Y2)(X3,Y3)(Width_X,Hight_Y)--Only when button-type is 0
		 */
		touchpanel,button-type = <4>;
		touchpanel.button-TRx = <0 0>;
	};
};
//#endif
/* TOUCH start */
&touch {
	tpd-resolution = <1080 1920>;
	use-tpd-button = <0>;
	tpd-key-num = <3>;
	tpd-key-local= <139 172 158 0>;
	tpd-key-dim-local = <90 883 100 40 230 883 100 40 370 883 100 40 0 0 0 0>;
	tpd-max-touch-num = <5>;
	tpd-filter-enable = <1>;
	tpd-filter-pixel-density = <146>;
	tpd-filter-custom-prameters = <0 0 0 0 0 0 0 0 0 0 0 0>;
	tpd-filter-custom-speed = <0 0 0>;
	pinctrl-names = "default", "state_eint_as_int",
		"state_eint_output0", "state_eint_output1",
		"state_rst_output0", "state_rst_output1";
	pinctrl-0 = <&ctp_pins_default>;
	pinctrl-1 = <&ctp_pins_eint_as_int>;
	pinctrl-2 = <&ctp_pins_eint_output0>;
	pinctrl-3 = <&ctp_pins_eint_output1>;
	pinctrl-4 = <&ctp_pins_rst_output0>;
	pinctrl-5 = <&ctp_pins_rst_output1>;
	status = "okay";
};
&pio {
	ctp_pins_default: eint0default {
	};
	ctp_pins_eint_as_int: eint@0 {
		pins_cmd_dat {
			pinmux = <PINMUX_GPIO1__FUNC_GPIO1>;
			slew-rate = <0>;
			bias-disable;
		};
	};
	ctp_pins_eint_output0: eintoutput0 {
		pins_cmd_dat {
			pinmux = <PINMUX_GPIO1__FUNC_GPIO1>;
			slew-rate = <1>;
			output-low;
		};
	};
	ctp_pins_eint_output1: eintoutput1 {
		pins_cmd_dat {
			pinmux = <PINMUX_GPIO1__FUNC_GPIO1>;
			slew-rate = <1>;
			output-high;
		};
	};
	ctp_pins_rst_output0: rstoutput0 {
		pins_cmd_dat {
			pinmux = <PINMUX_GPIO2__FUNC_GPIO2>;
			slew-rate = <1>;
			output-low;
		};
	};
	ctp_pins_rst_output1: rstoutput1 {
		pins_cmd_dat {
			pinmux = <PINMUX_GPIO2__FUNC_GPIO2>;
			slew-rate = <1>;
			output-high;
		};
	};
};

/* TOUCH end */
//#ifdef VENDOR_EDIT
&fuelgauge{
	enabled = <0>;
};
//#endif

/* CONSYS GPIO standardization */
&pio {
	consys_pins_default: consys_default {
	};
	gpslna_pins_init: gpslna@0 {
		pins_cmd_dat {
			pinmux = <PINMUX_GPIO169__FUNC_GPIO169>;
			//#ifndef VENDOR_EDIT
			//modify for: [GPS_LNA gpio's output direction is out]
			/*
			slew-rate = <0>;
			*/
			//#else /* VENDOR_EDIT */
			slew-rate = <1>;
			//#endif /* VENDOR_EDIT */
			bias-disable;
			output-low;
		};
	};
	gpslna_pins_oh: gpslna@1 {
		pins_cmd_dat {
			pinmux = <PINMUX_GPIO169__FUNC_GPIO169>;
			slew-rate = <1>;
			output-high;
		};
	};
	gpslna_pins_ol: gpslna@2 {
		pins_cmd_dat {
			pinmux = <PINMUX_GPIO169__FUNC_GPIO169>;
			slew-rate = <1>;
			output-low;
		};
	};
};
&consys {
	pinctrl-names = "default", "gps_lna_state_init", "gps_lna_state_oh", "gps_lna_state_ol";
	pinctrl-0 = <&consys_pins_default>;
	pinctrl-1 = <&gpslna_pins_init>;
	pinctrl-2 = <&gpslna_pins_oh>;
	pinctrl-3 = <&gpslna_pins_ol>;
	status = "okay";
};
/* CONSYS end */
/* UART GPIO */
&apuart0 {
	pinctrl-names = "uart0_gpio_default",
			"uart0_rx_set",
			"uart0_rx_clear",
			"uart0_tx_set",
			"uart0_tx_clear",
//#ifdef VENDOR_EDIT
			"uart0_rx_gpio",
			"uart0_tx_gpio";
//#endif /*VENDOR_EDIT*/
	pinctrl-0 = <&uart0_gpio_def_cfg>;
	pinctrl-1 = <&uart0_rx_set_cfg>;
	pinctrl-2 = <&uart0_rx_clr_cfg>;
	pinctrl-3 = <&uart0_tx_set_cfg>;
	pinctrl-4 = <&uart0_tx_clr_cfg>;
//#ifdef VENDOR_EDIT
	pinctrl-5 = <&uart0_rx_gpio_input>;
	pinctrl-6 = <&uart0_tx_gpio_input>;
//#endif /*VENDOR_EDIT*/
	status = "okay";
};

&pio {
	/* UART GPIO Settings - Start */
	/* UART0: rx set, rx clear, tx clear, tx clear*/
	uart0_gpio_def_cfg:uart0gpiodefault {

	};
	uart0_rx_set_cfg:uart0_rx_set@gpio95 {
		pins_cmd_dat {
			pinmux = <PINMUX_GPIO95__FUNC_URXD0>;
		};
	};
	uart0_rx_clr_cfg:uart0_rx_clear@gpio95 {
		pins_cmd_dat {
			pinmux = <PINMUX_GPIO95__FUNC_GPIO95>;
			slew-rate = <1>;
			output-high;
		};
	};
	uart0_tx_set_cfg:uart0_tx_set@gpio96 {
		pins_cmd_dat {
			pinmux = <PINMUX_GPIO96__FUNC_UTXD0>;
		};
	};
	uart0_tx_clr_cfg:uart0_tx_clear@gpio96 {
		pins_cmd_dat {
			pinmux = <PINMUX_GPIO96__FUNC_GPIO96>;
			slew-rate = <1>;
			output-high;
		};
	};
//#ifdef VENDOR_EDIT
	uart0_rx_gpio_input:uart0_rx_gpio@gpio95 {
		pins_cmd_dat {
			pinmux = <PINMUX_GPIO95__FUNC_GPIO95>;
			input-enable;
			slew-rate = <0>;
			bias-disable;
		};
	};
	uart0_tx_gpio_input:uart0_tx_gpio@gpio96 {
		pins_cmd_dat {
			pinmux = <PINMUX_GPIO96__FUNC_GPIO96>;
			input-enable;
			slew-rate = <0>;
			bias-disable;
		};
	};
//#endif /*VENDOR_EDIT*/
};/* UART GPIO end */

/* IRTX GPIO Start */
&irtx_pwm {
	pinctrl-names = "irtx_gpio_led_default", "irtx_gpio_led_set";
	pinctrl-0 = <&irtx_gpio_led_default>;
	pinctrl-1 = <&irtx_gpio_led_set>;
	status = "okay";
};
&pio {
	/* IRTX GPIO Settings -Start */
	/* default: GPIO0, output, high */
	irtx_gpio_led_default:irtx_gpio_led_def@gpio90 {
		pins_cmd_dat {
			pinmux = <PINMUX_GPIO90__FUNC_GPIO90>;
			slew-rate = <1>;
			bias-disable;
			output-low;
			input-schmitt-enable = <0>;
		};
	};

	irtx_gpio_led_set:irtx_gpio_led_set@gpio90 {
		pins_cmd_dat {
			pinmux = <PINMUX_GPIO90__FUNC_PWM_A>;
			slew-rate = <1>;
			output-high;
		};
	};
}; /* IRTX GPIO Settings -End */

&mt6370_pmu {
//#ifdef VENDOR_EDIT
	//mt6370,intr_gpio_num = <10>; /* direct defined GPIO num */
	//mt6370,intr_gpio = <&pio 10 0x0>;
//#else
	mt6370,intr_gpio_num = <91>; /* direct defined GPIO num */
	mt6370,intr_gpio = <&pio 91 0x0>;
//#endif
};

&mt6370_typec {
	mt6370pd,intr_gpio_num = <41>; /* direct defined GPIO num */
	mt6370pd,intr_gpio = <&pio 41 0x0>;
//#ifdef VENDOR_EDIT
	mt-tcpc,role_def = <0>;
//#endif
};

//#ifdef VENDOR_EDIT
&ssusb_ip_sleep {
	status = "disabled";
};
//#endif /*VENDOR_EDIT*/

//#ifdef VENDOR_EDIT
&i2c6 {
	pinctrl-names = "i2c-state", "output-low-state";
	pinctrl-0 = <&fg_i2c_state>;
	pinctrl-1 = <&fg_i2c_output_low_state>;
};

&pio {
	fg_i2c_state: fg_i2c_sda_state {
		pins_cmd_dat {
			pinmux = <PINMUX_GPIO12__FUNC_SDA6>;
			slew-rate = <0>;
			bias-disable;
		};
	};
	fg_i2c_output_low_state: fg_i2c_sda_output_low_state {
		pins_cmd_dat {
			pinmux = <PINMUX_GPIO12__FUNC_GPIO12>;
			slew-rate = <1>;
			output-low;
		};
	};
};
//#endif /* VENDOR_EDIT */

/* USB TYPEC GPIO start */
&pio {
	usb_default: usb_default {
	};
/*
	gpio_redriver_c1_init: c1_init {
		pins_cmd_dat {
			pinmux = <PINMUX_GPIO18__FUNC_GPIO18>;
			slew-rate = <1>;
			output-low;
		};
	};

	gpio_redriver_c1_low: c1_low {
		pins_cmd_dat {
			pinmux = <PINMUX_GPIO18__FUNC_GPIO18>;
			slew-rate = <1>;
			output-low;
		};
	};

	gpio_redriver_c1_hiz: c1_highz {
		pins_cmd_dat {
			pinmux = <PINMUX_GPIO18__FUNC_GPIO18>;
			slew-rate= <0>;
			bias-disable;
		};
	};

	gpio_redriver_c1_high: c1_high {
		pins_cmd_dat {
			pinmux = <PINMUX_GPIO18__FUNC_GPIO18>;
			slew-rate = <1>;
			output-high;
		};
	};

	gpio_redriver_c2_init: c2_init {
		pins_cmd_dat {
			pinmux = <PINMUX_GPIO17__FUNC_GPIO17>;
			slew-rate = <1>;
			output-low;
		};
	};

	gpio_redriver_c2_low: c2_low {
		pins_cmd_dat {
			pinmux = <PINMUX_GPIO17__FUNC_GPIO17>;
			slew-rate = <1>;
			output-low;
		};
	};

	gpio_redriver_c2_hiz: c2_highz {
		pins_cmd_dat {
			pinmux = <PINMUX_GPIO17__FUNC_GPIO17>;
			slew-rate= <0>;
			bias-disable;
		};
	};

	gpio_redriver_c2_high: c2_high {
		pins_cmd_dat {
			pinmux = <PINMUX_GPIO17__FUNC_GPIO17>;
			slew-rate = <1>;
			output-high;
		};
	};

	gpio_u3_switch_sel1: u3_sw_sel1 {
		pins_cmd_dat {
			pinmux = <PINMUX_GPIO177__FUNC_GPIO177>;
			slew-rate = <1>;
			output-low;
		};
	};

	gpio_u3_switch_sel2: u3_sw_sel2 {
		pins_cmd_dat {
			pinmux = <PINMUX_GPIO177__FUNC_GPIO177>;
			slew-rate = <1>;
			output-high;
		};
	};
*/
//#else
	gpio_redriver_c1_init: c1_init {
	};

	gpio_redriver_c1_low: c1_low {
	};

	gpio_redriver_c1_hiz: c1_highz {
	};

	gpio_redriver_c1_high: c1_high {
	};

	gpio_redriver_c2_init: c2_init {
	};

	gpio_redriver_c2_low: c2_low {
	};

	gpio_redriver_c2_hiz: c2_highz {
	};

	gpio_redriver_c2_high: c2_high {
	};

	gpio_u3_switch_sel1: u3_sw_sel1 {
	};

	gpio_u3_switch_sel2: u3_sw_sel2 {
	};
//#endif /*VENDOR_EDIT*/
	gpio_u3_switch_enable: u3_sw_en {
	};

	gpio_u3_switch_disable: u3_sw_dis {
	};
};

&usb_c_pinctrl {
	pinctrl-names = "usb_default",
		"redrv_c1_init",
		"redrv_c1_low",
		"redrv_c1_hiz",
		"redrv_c1_high",
		"redrv_c2_init",
		"redrv_c2_low",
		"redrv_c2_hiz",
		"redrv_c2_high",
		"switch_sel1",
		"switch_sel2",
		"switch_enable",
		"switch_disable";

	pinctrl-0 = <&usb_default>;
	pinctrl-1 = <&gpio_redriver_c1_init>;
	pinctrl-2 = <&gpio_redriver_c1_low>;
	pinctrl-3 = <&gpio_redriver_c1_hiz>;
	pinctrl-4 = <&gpio_redriver_c1_high>;
	pinctrl-5 = <&gpio_redriver_c2_init>;
	pinctrl-6 = <&gpio_redriver_c2_low>;
	pinctrl-7 = <&gpio_redriver_c2_hiz>;
	pinctrl-8 = <&gpio_redriver_c2_high>;
	pinctrl-9 = <&gpio_u3_switch_sel1>;
	pinctrl-10 = <&gpio_u3_switch_sel2>;
	pinctrl-11 = <&gpio_u3_switch_enable>;
	pinctrl-12 = <&gpio_u3_switch_disable>;
	status = "okay";

	usb_switch-data {
		en_pin_num = <0>;
		en_pin_val = <0>; /*DISABLE=0 ENABLE=1*/
		sel_pin_num = <177>;
		sel_pin_val = <1>; /*CC1=1, CC2=2*/
		c1_pin_num = <18>;
		c1_pin_val = <2>; /*Low=0, HighZ=1, High=2*/
		c2_pin_num = <17>;
		c2_pin_val = <1>;
	};
};
/* USB TYPEC GPIO end */

//#ifdef VENDOR_EDIT
&keypad {
	keypad,volume-up	= <&pio 20 0x00>;
	keypad,volume-down	= <&pio 94 0x00>;
	pinctrl-names = "volume_up_as_int", "volume_down_as_int";
	pinctrl-0 = <&volume_up_gpio_eint>;
	pinctrl-1 = <&volume_down_gpio_eint>;
	status = "okay";
};

&pio {
	volume_up_gpio_eint:volume_up@0{
		pins_cmd_dat {
			pinmux = <PINMUX_GPIO20__FUNC_GPIO20>;
			slew-rate = <0>;  /*direction 0:in, 1:out*/
			bias-pull-up = <00>;
			input-enable;
		};
	};
	volume_down_gpio_eint:volume_down@0{
		pins_cmd_dat {
			pinmux = <PINMUX_GPIO94__FUNC_GPIO94>;
			slew-rate = <0>;  /*direction 0:in, 1:out*/
			bias-pull-up = <00>;
			input-enable;
		};
	};
};
//#endif /*VENDOR_EDIT*/

&charger {
	algorithm_name = "DualSwitchCharging";
	chg1_ta_ac_charger_current = <2000000>;
	chg2_ta_ac_charger_current = <2000000>;
};
&pio {
	charger_pins_default: eint0default {
	};
	charger_pins_eint_output0: charger_gpio_as_output_low {
		pins_cmd_dat {
			pinmux = <PINMUX_GPIO97__FUNC_GPIO97>;
			slew-rate = <1>;
			output-low;
		};
	};
	charger_pins_eint_output1: charger_gpio_as_output_high {
		pins_cmd_dat {
			pinmux = <PINMUX_GPIO97__FUNC_GPIO97>;
			slew-rate = <1>;
			output-high;
		};
	};

	ship_sleep_gpio: ship_sleep {
		pins_cmd_dat {
			pinmux = <PINMUX_GPIO155__FUNC_GPIO155>;
			slew-rate = <1>;
			output-low;
		};
	};
	ship_active_gpio: ship_active {
		pins_cmd_dat {
			pinmux = <PINMUX_GPIO155__FUNC_GPIO155>;
			slew-rate = <1>;
			output-high;
		};
	};
	dischg_enable: dischg_enable {
		pins_cmd_dat {
			pinmux = <PINMUX_GPIO17__FUNC_GPIO17>;
			slew-rate = <1>;//0:input direction 1:output direction
			bias-pull-up = <00>;
			output-high;
		};
	};
	dischg_disable: dischg_disable {
		pins_cmd_dat {
			pinmux = <PINMUX_GPIO17__FUNC_GPIO17>;
			slew-rate = <1>;
			bias-pull-down = <00>;
			output-low;
		};
	};
	shortc_active_gpio: shortc_active {
		pins_cmd_dat {
			pinmux = <PINMUX_GPIO77__FUNC_GPIO77>;
			input-enable;
			slew-rate = <0>;
			bias-pull-up;
		};
	};
};

//#ifdef VENDOR_EDIT
&i2c6 {
	bq27541-battery@55 {
		status = "okay";
		compatible = "oplus,bq27541-battery";
		reg = <0x55 0>;
		qcom,modify-soc-smooth;
	};

	stm8s_fastcg@26{
		status = "okay";
		compatible = "oplus,stm8s-fastcg";
		reg = <0x26 0>;
		qcom,vooc-low-temp = <120>;
		qcom,oplus_batt_4400mv;
		qcom,vooc_fw_update_newmethod;
		qcom,vooc-fw-type = <8>;

		pinctrl-names = "switch1_act_switch2_act", "switch1_sleep_switch2_sleep",
						"switch1_act_switch3_act", "switch1_sleep_switch3_sleep",
						"switch1_act_switch2_sleep", "switch1_sleep_switch2_act",
						"clock_active","clock_sleep",
						"data_active","data_sleep",
						"reset_active","reset_sleep";
		pinctrl-0 = <&charging_switch1_active>;
		pinctrl-1 = <&charging_switch1_sleep>;
		pinctrl-2 = <&charging_switch1_active>;
		pinctrl-3 = <&charging_switch1_sleep>;
		pinctrl-4 = <&charging_switch1_active>;
		pinctrl-5 = <&charging_switch1_sleep>;
		pinctrl-6 = <&charging_clock_active>;
		pinctrl-7 = <&charging_clock_sleep>;
		pinctrl-8 = <&charging_data_active>;
		pinctrl-9 = <&charging_data_sleep>;
		pinctrl-10 = <&charging_reset_active>;
		pinctrl-11 = <&charging_reset_sleep>;

		qcom,charging_switch1-gpio 		= <&pio 166 0x00>;
		//qcom,charging_switch2-gpio 		= <&tlmm 113 0x00>;
		//qcom,charging_switch3-gpio 		= <&tlmm 38 0x00>;

		qcom,charging_reset-gpio 			= <&pio 160 0x00>;
		qcom,charging_clock-gpio 			= <&pio 25 0x00>;
		qcom,charging_data-gpio 			= <&pio 26 0x00>;
	};

	rk826_fastcg@0a{
		status = "okay";
		compatible = "oplus,rk826-fastcg";
		reg = <0x0a 0>;
		qcom,vooc-low-temp = <120>;
		qcom,oplus_batt_4400mv;
		qcom,vooc_fw_update_newmethod;
		qcom,vooc-fw-type = <1>;

		pinctrl-names = "switch1_act_switch2_act", "switch1_sleep_switch2_sleep",
						"switch1_act_switch3_act", "switch1_sleep_switch3_sleep",
						"switch1_act_switch2_sleep", "switch1_sleep_switch2_act",
						"clock_active","clock_sleep",
						"data_active","data_sleep",
						"reset_active","reset_sleep",
						"charging_switch1_ctr1_active","charging_switch1_ctr1_sleep";
		pinctrl-0 = <&charging_switch1_active>;
		pinctrl-1 = <&charging_switch1_sleep>;
		pinctrl-2 = <&charging_switch1_active>;
		pinctrl-3 = <&charging_switch1_sleep>;
		pinctrl-4 = <&charging_switch1_active>;
		pinctrl-5 = <&charging_switch1_sleep>;
		pinctrl-6 = <&charging_clock_active>;
		pinctrl-7 = <&charging_clock_sleep>;
		pinctrl-8 = <&charging_data_active>;
		pinctrl-9 = <&charging_data_sleep>;
		pinctrl-10 = <&charging_reset_active>;
		pinctrl-11 = <&charging_reset_sleep>;
		pinctrl-12 = <&charging_switch1_ctr1_active>;
		pinctrl-13 = <&charging_switch1_ctr1_sleep>;

		qcom,charging_switch1-gpio 		= <&pio 166 0x00>;
		qcom,charging_switch1_ctr1-gpio 	= <&pio 123 0x00>;
		//qcom,charging_switch2-gpio 		= <&tlmm 113 0x00>;
		//qcom,charging_switch3-gpio 		= <&tlmm 38 0x00>;

		qcom,charging_reset-gpio 			= <&pio 160 0x00>;
		qcom,charging_clock-gpio 			= <&pio 25 0x00>;
		qcom,charging_data-gpio 			= <&pio 26 0x00>;
	};

	op10_fastcg@06{
		status = "okay";
		compatible = "oplus,op10-fastcg";
		reg = <0x06 0>;
		qcom,vooc-low-temp = <120>;
		qcom,oplus_batt_4400mv;
		//qcom,vooc_fw_update_newmethod;
		qcom,vooc-fw-type = <1>;

		pinctrl-names = "switch1_act_switch2_act", "switch1_sleep_switch2_sleep",
						"switch1_act_switch3_act", "switch1_sleep_switch3_sleep",
						"switch1_act_switch2_sleep", "switch1_sleep_switch2_act",
						"clock_active","clock_sleep",
						"data_active","data_sleep",
						"reset_active","reset_sleep",
						"charging_switch1_ctr1_active","charging_switch1_ctr1_sleep";
		pinctrl-0 = <&charging_switch1_active>;
		pinctrl-1 = <&charging_switch1_sleep>;
		pinctrl-2 = <&charging_switch1_active>;
		pinctrl-3 = <&charging_switch1_sleep>;
		pinctrl-4 = <&charging_switch1_active>;
		pinctrl-5 = <&charging_switch1_sleep>;
		pinctrl-6 = <&charging_clock_active>;
		pinctrl-7 = <&charging_clock_sleep>;
		pinctrl-8 = <&charging_data_active>;
		pinctrl-9 = <&charging_data_sleep>;
		pinctrl-10 = <&charging_reset_active>;
		pinctrl-11 = <&charging_reset_sleep>;
		pinctrl-12 = <&charging_switch1_ctr1_active>;
		pinctrl-13 = <&charging_switch1_ctr1_sleep>;

		qcom,charging_switch1-gpio 		= <&pio 166 0x00>;
		qcom,charging_switch1_ctr1-gpio 	= <&pio 123 0x00>;
		//qcom,charging_switch2-gpio 		= <&tlmm 113 0x00>;
		//qcom,charging_switch3-gpio 		= <&tlmm 38 0x00>;

		qcom,charging_reset-gpio 			= <&pio 160 0x00>;
		qcom,charging_clock-gpio 			= <&pio 25 0x00>;
		qcom,charging_data-gpio 			= <&pio 26 0x00>;
	};
};
//#endif /* VENDOR_EDIT */

&pio {
	charging_switch1_ctr1_active: charging_switch1_ctr1_active {
		pins_cmd_dat {
			pinmux = <PINMUX_GPIO123__FUNC_GPIO123>;
			slew-rate = <1>;
			output-high;
		};
	};
	charging_switch1_ctr1_sleep: charging_switch1_ctr1_sleep {
		pins_cmd_dat {
			pinmux = <PINMUX_GPIO123__FUNC_GPIO123>;
			slew-rate = <1>;
			output-low;
		};
	};
	charging_switch1_active: charging_switch1_active {
		pins_cmd_dat {
			pinmux = <PINMUX_GPIO166__FUNC_GPIO166>;
			slew-rate = <1>;
			output-high;
		};
	};
	charging_switch1_sleep: charging_switch1_sleep {
		pins_cmd_dat {
			pinmux = <PINMUX_GPIO166__FUNC_GPIO166>;
			slew-rate = <1>;
			output-low;
		};
	};
	charging_clock_active: charging_clock_active {
		pins_cmd_dat {
			pinmux = <PINMUX_GPIO25__FUNC_GPIO25>;
			slew-rate = <0>;
			bias-pull-up = <00>;
		};
	};
	charging_clock_sleep: charging_clock_sleep {
		pins_cmd_dat {
			pinmux = <PINMUX_GPIO25__FUNC_GPIO25>;
			slew-rate = <0>;
			bias-pull-down = <00>;
		};
	};
	charging_data_active: charging_data_active {
		pins_cmd_dat {
			pinmux = <PINMUX_GPIO26__FUNC_GPIO26>;
			slew-rate = <0>;
			bias-pull-up = <00>;
		};
	};
	charging_data_sleep: charging_data_sleep {
		pins_cmd_dat {
			pinmux = <PINMUX_GPIO26__FUNC_GPIO26>;
			slew-rate = <0>;
			bias-pull-down = <00>;
		};
	};
	charging_reset_active: charging_reset_active {
		pins_cmd_dat {
			pinmux = <PINMUX_GPIO160__FUNC_GPIO160>;
			slew-rate = <1>;
			output-high;
		};
	};
	charging_reset_sleep: charging_reset_sleep {
		pins_cmd_dat {
			pinmux = <PINMUX_GPIO160__FUNC_GPIO160>;
			slew-rate = <1>;
			output-low;
		};
	};
};


/* #ifdef OPLUS_BUG_STABILITY */
&pio {
	mtkfb_pins_mode_te_gpio: mode_te_gpio {
		pins_cmd_dat {
			pinmux = <PINMUX_GPIO44__FUNC_GPIO44>;
	};
		};

	mtkfb_pins_mode_te_te: mode_te_te {
		pins_cmd_dat {
			pinmux = <PINMUX_GPIO44__FUNC_DSI_TE>;
		};
	};

	mtkfb_pins_lcm_reset0: lcm_rst_out0_gpio {
		pins_cmd_dat {
			pinmux = <PINMUX_GPIO45__FUNC_GPIO45>;
			slew-rate = <1>;
			output-low;
		};
	};

	mtkfb_pins_lcm_reset1: lcm_rst_out1_gpio {
		pins_cmd_dat {
			pinmux = <PINMUX_GPIO45__FUNC_GPIO45>;
			slew-rate = <1>;
			output-high;
		};
	};


	mtkfb_pins_lcd_vci_en0: lcd_vci_en0_gpio {
		pins_cmd_dat {
			pinmux = <PINMUX_GPIO46__FUNC_GPIO46>;
			slew-rate = <1>;
			output-low;
		};
	};

	mtkfb_pins_lcd_vci_en1: lcd_vci_en1_gpio {
		pins_cmd_dat {
			pinmux = <PINMUX_GPIO46__FUNC_GPIO46>;
			slew-rate = <1>;
			output-high;
		};
	};

	mtkfb_pins_lcd_mipi_err_en0: lcd_mipi_err_en0_gpio {
		pins_cmd_dat {
			pinmux = <PINMUX_GPIO9__FUNC_GPIO9>;
			slew-rate = <1>;
			output-low;
		};
	};

	mtkfb_pins_lcd_mipi_err_en1: lcd_mipi_err_en1_gpio {
		pins_cmd_dat {
			pinmux = <PINMUX_GPIO9__FUNC_GPIO9>;
			slew-rate = <1>;
			output-high;
		};
	};

	mtkfb_pins_default: default {
};
};

&mtkfb {
	pinctrl-names = "default", "mode_te_gpio", "mode_te_te", "lcm_rst_out0_gpio",
	"lcm_rst_out1_gpio", "lcd_vci_en0_gpio", "lcd_vci_en1_gpio",
	"lcd_mipi_err_en0_gpio", "lcd_mipi_err_en1_gpio";
	pinctrl-0 = <&mtkfb_pins_default>;
	pinctrl-1 = <&mtkfb_pins_mode_te_gpio>;
	pinctrl-2 = <&mtkfb_pins_mode_te_te>;
	pinctrl-3 = <&mtkfb_pins_lcm_reset0>;
	pinctrl-4 = <&mtkfb_pins_lcm_reset1>;
	pinctrl-5 = <&mtkfb_pins_lcd_vci_en0>;
	pinctrl-6 = <&mtkfb_pins_lcd_vci_en1>;
	pinctrl-7 = <&mtkfb_pins_lcd_mipi_err_en0>;
	pinctrl-8 = <&mtkfb_pins_lcd_mipi_err_en1>;
	status = "okay";
	oplus_display_aod_support;
	oplus_display_tenbits_support;
	oplus_display_bl_set_on_lcd_esd_recovery;
};
/* #endif OPLUS_BUG_STABILITY */


&pio{
    gpio_goodix_reset_default: gpio_goodix_reset_default {
        pins_cmd_dat {
            pinmux = <PINMUX_GPIO43__FUNC_GPIO43>;
            output-low;
        };
    };
    gpio_goodix_irq_default: gpio_goodix_irq_default {
        pins_cmd_dat {
            pinmux = <PINMUX_GPIO10__FUNC_GPIO10>;
            bias-pull-down;
        };
    };
    //#ifdef VENDOR_EDIT
    gpio_goodix_clk_6mA: gpio_goodix_clk_6mA {
        pins_cmd_dat {
            pinmux = <PINMUX_GPIO88__FUNC_SPI0_CLK>;
            drive-strength = <2>;
        };
    };
    gpio_goodix_mosi_6mA: gpio_goodix_mosi_6mA {
        pins_cmd_dat {
            pinmux = <PINMUX_GPIO87__FUNC_SPI0_MO>;
            drive-strength = <2>;
        };
    };
    gpio_goodix_miso_6mA: gpio_goodix_miso_6mA {
        pins_cmd_dat {
            pinmux = <PINMUX_GPIO85__FUNC_SPI0_MI>;
            drive-strength = <3>;
        };
    };
    gpio_goodix_cs_6mA: gpio_goodix_cs_6mA {
        pins_cmd_dat {
            pinmux = <PINMUX_GPIO86__FUNC_SPI0_CSB>;
            drive-strength = <2>;
        };
    };
    gpio_goodix_cs_func: gpio_goodix_cs_func {
        pins_cmd_dat {
            pinmux = <PINMUX_GPIO86__FUNC_SPI0_CSB>;
            drive-strength = <2>;
        };
    };
    //#endif /*VENDOR_EDIT*/
};
//ifdef VENDOR_EDIT
&spi0 {
    #address-cells = <1>;
    #size-cells = <0>;
    status = "okay";
    oppo_fp: fingerprint@0 {
        compatible = "oppo,oppo_fp";
        reg = <0>;
        spi-max-frequency = <8000000>;
        spi-id = <0>;
        spi-irq = <10>;
        spi-reg = <11010000>;
        //avdd-supply = <&mt_pmic_vfp_ldo_reg>;
        status = "okay";
        pw_en_gpio = <&pio 176 0x00>;
        avdd-config = <1800000 1800000 150000>;
        power_source_1 {
            power-mode = <2>;
            power-name = "pw_en_gpio";
            poweron-level = <1>;
            delay-time = <0>;
        };
        power_source_2 {
            power-mode = <1>;
            power-name = "avdd";
            power-config = "avdd-config";
            delay-time = <0>;
        };
    };
};
//#endif /* VENDOR_EDIT */
&mt6370_pmu {
	ldo {
		mt6370_ldo {
		/* change name by yourself */
		//regulator-name = "irtx_ldo";
		regulator-name = "avdd";
		regulator-min-microvolt = <1600000>;

		/* max == min then apply_uV = 1 */
		regulator-max-microvolt = <4000000>;

		/* optional */
		/* regulator-microvolt-offset = <0>; */

		/* optional: exist = enabled */
		/* regulator-boot-on; */

		/* optional: exist = enabled */
		/* regulator-always-on; */

		/* optional */
		/* regulator-ramp-delay = <100>; */
		};
	};
};
&goodix_fp {
    goodix,gpio_irq = <&pio 10 0x00>;
    goodix,gpio_reset = <&pio 43 0x00>;
    //#ifdef VENDOR_EDIT
    goodix,pw_en = <&pio 176 0x00>;
    //#endif /* VENDOR_EDIT */
    goodix,gpio_cs = <&pio 86 0x00>;
    pinctrl-names = "default", "gf_spi_drive_6mA", "gf_cs_func";
    pinctrl-0 = <&gpio_goodix_irq_default>, <&gpio_goodix_reset_default>;
    pinctrl-1 = <&gpio_goodix_clk_6mA>, <&gpio_goodix_mosi_6mA>, <&gpio_goodix_miso_6mA>, <&gpio_goodix_cs_6mA>;
    pinctrl-2 = <&gpio_goodix_cs_func>;
    status = "okay";
};

//ifdef VENDOR_EDIT
/*the id config to project dts.*/
&pio{
	gpio_id0_default: gpio_id0_default {
		pins_cmd_dat {
			pinmux = <PINMUX_GPIO13__FUNC_GPIO13>;
			bias-pull-up = <00>;
			input-enable;
		};
	};
};

&oplus_fp_common {
	compatible = "oplus,fp_common"; //Manufacture, and Model
	oplus,fp_gpio_num = <1>;
	oplus,fp_gpio_0 = <&pio 13 0x00>;
	pinctrl-names = "default";
	pinctrl-0 = <&gpio_id0_default>;
	goodix_id {
		oplus,fp-id = <1>; /* fp id mapping table */
		vendor-chip = <11>; /* please refer to the struct fp_vendor_t in oppo_fp_commmon.n */
		eng-menu = "-1,-1"; /* represents SNR, inclination test item in engineer menu, and 0/1 means off/on */
		chip-name = "G_OPTICAL_G3";  /* /proc/fp_id, will be displayed in engineer menu  */
	};
	goodix_id2 {
		oplus,fp-id = <0>; /* fp id mapping table */
		vendor-chip = <11>; /* please refer to the struct fp_vendor_t in oppo_fp_commmon.n */
		eng-menu = "-1,-1"; /* represents SNR, inclination test item in engineer menu, and 0/1 means off/on */
		chip-name = "G_OPTICAL_G3";  /* /proc/fp_id, will be displayed in engineer menu  */
	};
};

//#ifdef VENDOR_EDIT

&pio {
    boost: boost {
        pins_cmd_dat {
            pinmux = <PINMUX_GPIO15__FUNC_GPIO15>;
            slew-rate = <1>;
            bias-pull-down; //pull down
            output-low; //digital output, no invert
            drive-strength = <2>;//0.15
        };
    };

    pwm_config: pwm_config {
        pins_cmd_dat {
            pinmux = <PINMUX_GPIO90__FUNC_PWM_A>;
            slew-rate = <1>;
            bias-disable;
            drive-strength = <0>;
        };
    };

    pwm_config_as_gpio: pwm_config_as_gpio {
        pins_cmd_dat {
            pinmux = <PINMUX_GPIO90__FUNC_GPIO90>;
            slew-rate = <1>;
            bias-disable;
            output-low;
            drive-strength = <0>; //LOW strength
        };
    };

    enable_gpio: enable_gpio {
        pins_cmd_dat {
            pinmux = <PINMUX_GPIO89__FUNC_GPIO89>;
            slew-rate = <1>;
            bias-disable; //No Pull
	    output-low;
            drive-strength = <0>; //LOW strength
        };
    };

    dir_gpio: dir_gpio {
        pins_cmd_dat {
            pinmux = <PINMUX_GPIO16__FUNC_GPIO16>;
            slew-rate = <1>;
            bias-disable;
            output-low;
            drive-strength = <0>; /* LOW strength */
        };
    };

    standby_gpio: standby_gpio {
        pins_cmd_dat {
            pinmux = <PINMUX_GPIO14__FUNC_GPIO14>;
            slew-rate = <1>;
            bias-disable;
            output-low; /* digital output, no invert */
            drive-strength = <0>; /* LOW strength */
        };
    };

    mode1_gpio: mode1_gpio {
        pins_cmd_dat {
            pinmux = <PINMUX_GPIO175__FUNC_GPIO175>;
            slew-rate = <1>;
            bias-disable;
            output-low;
            drive-strength = <0>; /* LOW strength */
        };
    };
};

&motor_pl {
	status = "okay";
	compatible = "oppo-motor";
	hall-irq-pos = <170>;
	motor-retard-pos = <430>;
        delay-cycle = <25 14 20>; //ms
        slow-delay-cycle = <28 28 28>; //ms
        full-speed-param = <55 13500>;
        up-speed-param = <5 13500>;
        down-speed-param = <3 156250>;
        nodetect-speed-param = <15 13500>;
        slow-full-speed-param = <60 31250>;
        slow-up-speed-param = <5 104166>;
        slow-down-speed-param = <3 156250>;
        slow-nodetect-speed-param = <15 104166>;
        stop-neg-point = <2 2>;
        stop-pos-point = <2 2>;
        terminal-offset = <25 25>;
        offset-stop-retry = <2>;
        //pos-change-thrd = <300 350>;
        hall-data-sign = <0>;//1 represent positive ,0 represent negative
        press-irq-makeup = <55 55>;
        stop-retry = <4>;
        //motor_stop_val_support;
        //motor_stop_val = <2 1>;
        motor_down_stop_support;
        motor_down_stop_val = <1>;
        //cal_stop_pos_val = <3 3>;
        cal_stop_val = <1 1>;
        full_stop_val = <3 50>;
        cal_fix_stop_retry_support;
        cal_fix_stop_retry = <4>;
        motor_retard_offset_support;
        //motor_modify_stopcount_support;
        motor_small_irq_later_speed_down_support;
        small-irq-later-speed-down = <400 15 10>;
        /*
        support mag noise decrease:
        511 - pattern[0] = irq_max
        pattern[1] - 512 = irq_min
        511 - pattern[2] = normal_max
        pattern[3] - 512 = normal_min
        average = 200
        */
	mag_noise_support;
	mag_noise_pattern = <80 400 0 662 200 100 100>;
};

&motor_drv {
        status = "okay";
        compatible = "motor_drv-220";
        pinctrl-names = "boost","pwm_config","pwm_config_as_gpio","enable_gpio","dir_gpio","standby_gpio","mode1_gpio";
        pinctrl-0 = <&boost>;
        pinctrl-1 = <&pwm_config>;
        pinctrl-2 = <&pwm_config_as_gpio>;
        pinctrl-3 = <&enable_gpio>;
        pinctrl-4 = <&dir_gpio>;
        pinctrl-5 = <&standby_gpio>;
        pinctrl-6 = <&mode1_gpio>;
        boost-gpio = <&pio 15 0x00>;
        standby-gpio = <&pio 14 0>;
        dir-gpio = <&pio 16 0>;
        enable-gpio =  <&pio 89 0>;
        step-gpio = <&pio 90 0>;
        mode1-gpio = <&pio 175 0>;
        ratio-a = <24>;
        ratio-b = <1840>;//18.40
        ratio-c = <20>;
        ratio-d = <32>;
};

&i2c3 {
    dhall0-m1120@0f {
        status = "okay";
        compatible = "oppo,dhall-m1120";
        reg = <0x0f>;
        //pinctrl-names = "hall_power_down","hall_power_up","hall0_interrupt_input";
        pinctrl-names = "hall0_interrupt_input";
        //pinctrl-0 = <&hall_power_down>;
        //pinctrl-1 = <&hall_power_up>;
        //pinctrl-2 = <&hall0_interrupt_input>;
        pinctrl-0 = <&hall0_interrupt_input>;
        interrupt-parent = <&pio>;
        interrupts = <5 IRQ_TYPE_LEVEL_LOW 5 0>;
        dhall,irq-gpio = <&pio 5 0x2008>;
        dhall,id = <0>;
        //hall-power-gpio = <&pio 110 0>;
        hall,bias_support;
        hall,bias-ratio = <80>;// current/goal *100
    };

    dhall1-m1120@0c {
    	status = "okay";
        compatible = "oppo,dhall-m1120";
        reg = <0x0c>;
        //pinctrl-names = "hall_power_down","hall_power_up","hall1_interrupt_input";
        pinctrl-names = "hall1_interrupt_input";
        //pinctrl-0 = <&hall_power_down>;
        //pinctrl-1 = <&hall_power_up>;
        //pinctrl-2 = <&hall1_interrupt_input>;
        pinctrl-0 = <&hall1_interrupt_input>;
        interrupt-parent = <&pio>;
        interrupts = <6 IRQ_TYPE_LEVEL_LOW 6 0>;
        dhall,irq-gpio = <&pio 6 0x2008>;
        dhall,id = <1>;
        //hall-power-gpio = <&pio 110 0>;
        hall,bias_support;
        hall,bias-ratio = <80>;// current/goal *100
    };

    dhall0-ist8801@1b {
		status = "okay";
		compatible = "oppo,dhall-ist8801";
		reg = <0x1b>;
		//pinctrl-names = "hall_power_down","hall_power_up","hall0_interrupt_input";
		pinctrl-names = "hall0_interrupt_input";
		//pinctrl-0 = <&hall_power_down>;
		//pinctrl-1 = <&hall_power_up>;
		//pinctrl-2 = <&hall0_interrupt_input>;
		pinctrl-0 = <&hall0_interrupt_input>;
		interrupt-parent = <&pio>;
		interrupts = <5 IRQ_TYPE_LEVEL_LOW 5 0>;
		dhall,irq-gpio = <&pio 5 0x2008>;
		dhall,id = <0>;
		vdd_2v8-supply = <&mt_pmic_vio28_ldo_reg>;//VREG_3P0
		vcc_1v8-supply = <&mt_pmic_vio18_ldo_reg>;//VREG_1P8
		//hall-power-gpio = <&pio 110 0>;
		hall,bias_support;
		hall,bias-ratio = <80>;// current/goal *100
	};

	dhall1-ist8801@18 {
		status = "okay";
		compatible = "oppo,dhall-ist8801";
		reg = <0x18>;
		//pinctrl-names = "hall_power_down","hall_power_up","hall1_interrupt_input";
		pinctrl-names = "hall1_interrupt_input";
		//pinctrl-0 = <&hall_power_down>;
		//pinctrl-1 = <&hall_power_up>;
		//pinctrl-2 = <&hall1_interrupt_input>;
		pinctrl-0 = <&hall1_interrupt_input>;
		interrupt-parent = <&pio>;
		interrupts = <6 IRQ_TYPE_LEVEL_LOW 6 0>;
		dhall,irq-gpio = <&pio 6 0x2008>;
		dhall,id = <1>;
		vdd_2v8-supply = <&mt_pmic_vio28_ldo_reg>;//VREG_3P0
		vcc_1v8-supply = <&mt_pmic_vio18_ldo_reg>;//VREG_1P8
		//hall-power-gpio = <&pio 110 0>;
		hall,bias_support;
		hall,bias-ratio = <80>;// current/goal *100
	};
};

&pio {
    hall_power_up: hall_power_up {
        pins_cmd_dat {
            pinmux = <PINMUX_GPIO110__FUNC_GPIO110>;
            slew-rate = <1>;
            drive-strength = <2>;
            output-high;
            bias-pull-down;
		};
	};
    hall_power_down: hall_power_down {
        pins_cmd_dat {
            pinmux = <PINMUX_GPIO110__FUNC_GPIO110>;
            slew-rate = <1>;
            drive-strength = <2>;
            output-low;
            bias-pull-down;
        };
    };
    hall0_interrupt_input: hall0_interrupt_input {
        pins_cmd_dat {
            pinmux = <PINMUX_GPIO6__FUNC_GPIO6>;
            slew-rate = <0>;
            drive-strength = <2>;
            bias-disable; //No Pull
        };
    };
    hall1_interrupt_input: hall1_interrupt_input {
        pins_cmd_dat {
            pinmux = <PINMUX_GPIO5__FUNC_GPIO5>;
            slew-rate = <0>;
            drive-strength = <2>;
            bias-disable; //No Pull
        };
    };
};
//#endif
//#endif /* VENDOR_EDIT */
/* CAMERA GPIO standardization */
&pio {
	camera_pins_cam0_rst_0: cam0@0 {
		pins_cmd_dat {
			pinmux = <PINMUX_GPIO102__FUNC_GPIO102>;
			slew-rate = <1>; /*direction 0:in, 1:out*/
			output-low;/*direction out used only. output_low or high*/
		};
	};
	camera_pins_cam0_rst_1: cam0@1 {
		pins_cmd_dat {
			pinmux = <PINMUX_GPIO102__FUNC_GPIO102>;
			slew-rate = <1>;
			output-high;
		};
	};
	camera_pins_cam1_rst_0: cam1@0 {
		pins_cmd_dat {
			pinmux = <PINMUX_GPIO109__FUNC_GPIO109>;
			slew-rate = <1>; /*direction 0:in, 1:out*/
			output-low;/*direction out used only. output_low or high*/
		};
	};
	camera_pins_cam1_rst_1: cam1@1 {
		pins_cmd_dat {
			pinmux = <PINMUX_GPIO109__FUNC_GPIO109>;
			slew-rate = <1>;
			output-high;
		};
	};
	camera_pins_cam2_rst_0: cam2@0 {
		pins_cmd_dat {
			pinmux = <PINMUX_GPIO98__FUNC_GPIO98>;
			slew-rate = <1>;
			output-low;
		};
	};
	camera_pins_cam2_rst_1: cam2@1 {
		pins_cmd_dat {
			pinmux = <PINMUX_GPIO98__FUNC_GPIO98>;
			slew-rate = <1>;
			output-high;
		};
	};
        camera_pins_cam3_rst_0: cam3@0 {
                pins_cmd_dat {
                        pinmux = <PINMUX_GPIO177__FUNC_GPIO177>;
                        slew-rate = <1>;
                        output-low;
                };
        };
        camera_pins_cam3_rst_1: cam3@1 {
                pins_cmd_dat {
                        pinmux = <PINMUX_GPIO177__FUNC_GPIO177>;
                        slew-rate = <1>;
                        output-high;
                };
        };
        camera_pins_cam4_rst_0: cam4@0 {
                pins_cmd_dat {
                        pinmux = <PINMUX_GPIO101__FUNC_GPIO101>;
                        slew-rate = <1>;
                        output-low;
                };
        };
        camera_pins_cam4_rst_1: cam4@1 {
                pins_cmd_dat {
                        pinmux = <PINMUX_GPIO101__FUNC_GPIO101>;
                        slew-rate = <1>;
                        output-high;
                };
        };
	camera_pins_cam0_vcamd_0: cam0@vcam0 {
		pins_cmd_dat {
			pinmux = <PINMUX_GPIO179__FUNC_GPIO179>;
			slew-rate = <1>;
			output-low;
		};
	};
	camera_pins_cam0_vcamd_1: cam0@vcam1 {
		pins_cmd_dat {
			pinmux = <PINMUX_GPIO179__FUNC_GPIO179>;
			slew-rate = <1>;
			output-high;
		};
	};
	camera_pins_cam1_vcamd_0: cam1@vcamd0 {
		pins_cmd_dat {
			pinmux = <PINMUX_GPIO179__FUNC_GPIO179>;
			slew-rate = <1>;
			output-low;
		};
	};
	camera_pins_cam1_vcamd_1: cam1@vcamd1 {
		pins_cmd_dat {
			pinmux = <PINMUX_GPIO179__FUNC_GPIO179>;
			slew-rate = <1>;
			output-high;
		};
	};
	camera_pins_cam0_mclk_off: camera_pins_cam0_mclk_off {
		pins_cmd_dat {
			pinmux = <PINMUX_GPIO100__FUNC_GPIO100>;
			drive-strength = <1>;
		};
	};
        camera_pins_cam0_mclk_2ma: camera_pins_cam0_mclk_2ma {
		pins_cmd_dat {
			pinmux = <PINMUX_GPIO100__FUNC_CMMCLK1>;
			drive-strength = <0>;
		};
	};
	camera_pins_cam0_mclk_4ma: camera_pins_cam0_mclk_4ma {
		pins_cmd_dat {
			pinmux = <PINMUX_GPIO100__FUNC_CMMCLK1>;
			drive-strength = <1>;
		};
	};
	camera_pins_cam0_mclk_6ma: camera_pins_cam0_mclk_6ma {
		pins_cmd_dat {
			pinmux = <PINMUX_GPIO100__FUNC_CMMCLK1>;
			drive-strength = <2>;
		};
	};
	camera_pins_cam0_mclk_8ma: camera_pins_cam0_mclk_8ma {
		pins_cmd_dat {
			pinmux = <PINMUX_GPIO100__FUNC_CMMCLK1>;
			drive-strength = <3>;
		};
	};
	camera_pins_cam1_mclk_off: camera_pins_cam1_mclk_off {
		pins_cmd_dat {
			pinmux = <PINMUX_GPIO108__FUNC_GPIO108>;
			drive-strength = <1>;
		};
	};
	camera_pins_cam1_mclk_2ma: camera_pins_cam1_mclk_2ma {
		pins_cmd_dat {
			pinmux = <PINMUX_GPIO108__FUNC_CMMCLK2>;
			drive-strength = <0>;
		};
	};
	camera_pins_cam1_mclk_4ma: camera_pins_cam1_mclk_4ma {
		pins_cmd_dat {
			pinmux = <PINMUX_GPIO108__FUNC_CMMCLK2>;
			drive-strength = <1>;
		};
	};
	camera_pins_cam1_mclk_6ma: camera_pins_cam1_mclk_6ma {
		pins_cmd_dat {
			pinmux = <PINMUX_GPIO108__FUNC_CMMCLK2>;
			drive-strength = <2>;
		};
	};
	camera_pins_cam1_mclk_8ma: camera_pins_cam1_mclk_8ma {
		pins_cmd_dat {
			pinmux = <PINMUX_GPIO108__FUNC_CMMCLK2>;
			drive-strength = <3>;
		};
	};
	camera_pins_cam2_mclk_off: camera_pins_cam2_mclk_off {
		pins_cmd_dat {
			pinmux = <PINMUX_GPIO165__FUNC_GPIO165>;
			drive-strength = <1>;
		};
	};
	camera_pins_cam2_mclk_2ma: camera_pins_cam2_mclk_2ma {
		pins_cmd_dat {
			pinmux = <PINMUX_GPIO165__FUNC_CMMCLK2>;
			drive-strength = <0>;
		};
	};
	camera_pins_cam2_mclk_4ma: camera_pins_cam2_mclk_4ma {
		pins_cmd_dat {
			pinmux = <PINMUX_GPIO165__FUNC_CMMCLK2>;
			drive-strength = <1>;
		};
	};
	camera_pins_cam2_mclk_6ma: camera_pins_cam2_mclk_6ma {
		pins_cmd_dat {
			pinmux = <PINMUX_GPIO165__FUNC_CMMCLK2>;
			drive-strength = <2>;
		};
	};
	camera_pins_cam2_mclk_8ma: camera_pins_cam2_mclk_8ma {
		pins_cmd_dat {
			pinmux = <PINMUX_GPIO165__FUNC_CMMCLK2>;
			drive-strength = <3>;
		};
	};
        camera_pins_cam3_mclk_off: camera_pins_cam3_mclk_off {
                pins_cmd_dat {
                        pinmux = <PINMUX_GPIO111__FUNC_GPIO111>;
                        drive-strength = <1>;
                };
        };
        camera_pins_cam3_mclk_2ma: camera_pins_cam3_mclk_2ma {
                pins_cmd_dat {
                        pinmux = <PINMUX_GPIO111__FUNC_CMMCLK3>;
                        drive-strength = <0>;
                };
        };
        camera_pins_cam3_mclk_4ma: camera_pins_cam3_mclk_4ma {
                pins_cmd_dat {
                        pinmux = <PINMUX_GPIO111__FUNC_CMMCLK3>;
                        drive-strength = <1>;
                };
        };
        camera_pins_cam3_mclk_6ma: camera_pins_cam3_mclk_6ma {
                pins_cmd_dat {
                        pinmux = <PINMUX_GPIO111__FUNC_CMMCLK3>;
                        drive-strength = <2>;
                };
        };
        camera_pins_cam3_mclk_8ma: camera_pins_cam3_mclk_8ma {
                pins_cmd_dat {
                        pinmux = <PINMUX_GPIO111__FUNC_CMMCLK3>;
                        drive-strength = <3>;
                };
        };
        camera_pins_cam4_mclk_off: camera_pins_cam4_mclk_off {
                pins_cmd_dat {
                        pinmux = <PINMUX_GPIO99__FUNC_GPIO99>;
                        drive-strength = <1>;
                };
        };
        camera_pins_cam4_mclk_2ma: camera_pins_cam4_mclk_2ma {
                pins_cmd_dat {
                        pinmux = <PINMUX_GPIO99__FUNC_CMMCLK0>;
                        drive-strength = <0>;
                };
        };
        camera_pins_cam4_mclk_4ma: camera_pins_cam4_mclk_4ma {
                pins_cmd_dat {
                        pinmux = <PINMUX_GPIO99__FUNC_CMMCLK0>;
                        drive-strength = <1>;
                };
        };
        camera_pins_cam4_mclk_6ma: camera_pins_cam4_mclk_6ma {
                pins_cmd_dat {
                        pinmux = <PINMUX_GPIO99__FUNC_CMMCLK0>;
                        drive-strength = <2>;
                };
        };
        camera_pins_cam4_mclk_8ma: camera_pins_cam4_mclk_8ma {
                pins_cmd_dat {
                        pinmux = <PINMUX_GPIO99__FUNC_CMMCLK0>;
                        drive-strength = <3>;
                };
        };
        camera_mipi_switch_low: camera_mipi_switch_output_low@gpio76 {
                pins_cmd_dat {
                        pinmux = <PINMUX_GPIO76__FUNC_GPIO76>;
                        output-low;
                };
        };
        camera_mipi_switch_high: camera_mipi_switch_output_high@gpio76 {
                pins_cmd_dat {
                        pinmux = <PINMUX_GPIO76__FUNC_GPIO76>;
                        output-high;
                };
        };
	camera_pins_default: camdefault {
	};
};
&kd_camera_hw1 {
	pinctrl-names = "default",
			"cam0_rst0", "cam0_rst1",
			"cam1_rst0", "cam1_rst1",
			"cam2_rst0", "cam2_rst1",
                        "cam3_rst0", "cam3_rst1",
                        "cam4_rst0", "cam4_rst1",
			"cam0_ldo_vcamd_0", "cam0_ldo_vcamd_1",
			"cam1_ldo_vcamd_0", "cam1_ldo_vcamd_1",
			"cam0_mclk_off",
			"cam0_mclk_2mA", "cam0_mclk_4mA",
			"cam0_mclk_6mA", "cam0_mclk_8mA",
			"cam1_mclk_off",
			"cam1_mclk_2mA", "cam1_mclk_4mA",
			"cam1_mclk_6mA", "cam1_mclk_8mA",
			"cam2_mclk_off",
			"cam2_mclk_2mA", "cam2_mclk_4mA",
			"cam2_mclk_6mA", "cam2_mclk_8mA",
                        "cam3_mclk_off",
                        "cam3_mclk_2mA", "cam3_mclk_4mA",
                        "cam3_mclk_6mA", "cam3_mclk_8mA",
                        "cam4_mclk_off",
                        "cam4_mclk_2mA", "cam4_mclk_4mA",
                        "cam4_mclk_6mA", "cam4_mclk_8mA",
                        "cam_mipi_switch_en_0", "cam_mipi_switch_en_1";
	pinctrl-0 = <&camera_pins_default>;
	pinctrl-1 = <&camera_pins_cam0_rst_0>;
	pinctrl-2 = <&camera_pins_cam0_rst_1>;
	pinctrl-3 = <&camera_pins_cam1_rst_0>;
	pinctrl-4 = <&camera_pins_cam1_rst_1>;
	pinctrl-5 = <&camera_pins_cam2_rst_0>;
	pinctrl-6 = <&camera_pins_cam2_rst_1>;
        pinctrl-7 = <&camera_pins_cam3_rst_0>;
        pinctrl-8 = <&camera_pins_cam3_rst_1>;
        pinctrl-9 = <&camera_pins_cam4_rst_0>;
        pinctrl-10 = <&camera_pins_cam4_rst_1>;
	pinctrl-11 = <&camera_pins_cam0_vcamd_0>;
	pinctrl-12 = <&camera_pins_cam0_vcamd_1>;
	pinctrl-13 = <&camera_pins_cam1_vcamd_0>;
	pinctrl-14 = <&camera_pins_cam1_vcamd_1>;
	pinctrl-15 = <&camera_pins_cam0_mclk_off>;
	pinctrl-16 = <&camera_pins_cam0_mclk_2ma>;
	pinctrl-17 = <&camera_pins_cam0_mclk_4ma>;
	pinctrl-18 = <&camera_pins_cam0_mclk_6ma>;
	pinctrl-19 = <&camera_pins_cam0_mclk_8ma>;
	pinctrl-20 = <&camera_pins_cam1_mclk_off>;
	pinctrl-21 = <&camera_pins_cam1_mclk_2ma>;
	pinctrl-22 = <&camera_pins_cam1_mclk_4ma>;
	pinctrl-23 = <&camera_pins_cam1_mclk_6ma>;
	pinctrl-24 = <&camera_pins_cam1_mclk_8ma>;
	pinctrl-25 = <&camera_pins_cam2_mclk_off>;
	pinctrl-26 = <&camera_pins_cam2_mclk_2ma>;
	pinctrl-27 = <&camera_pins_cam2_mclk_4ma>;
	pinctrl-28 = <&camera_pins_cam2_mclk_6ma>;
	pinctrl-29 = <&camera_pins_cam2_mclk_8ma>;
        pinctrl-30 = <&camera_pins_cam3_mclk_off>;
        pinctrl-31 = <&camera_pins_cam3_mclk_2ma>;
        pinctrl-32 = <&camera_pins_cam3_mclk_4ma>;
        pinctrl-33 = <&camera_pins_cam3_mclk_6ma>;
        pinctrl-34 = <&camera_pins_cam3_mclk_8ma>;
        pinctrl-35 = <&camera_pins_cam4_mclk_off>;
        pinctrl-36 = <&camera_pins_cam4_mclk_2ma>;
        pinctrl-37 = <&camera_pins_cam4_mclk_4ma>;
        pinctrl-38 = <&camera_pins_cam4_mclk_6ma>;
        pinctrl-39 = <&camera_pins_cam4_mclk_8ma>;
        pinctrl-40 = <&camera_mipi_switch_low>;
        pinctrl-41 = <&camera_mipi_switch_high>;

        cam0_vcama-supply = <&mt_pmic_vcama1_ldo_reg>;
	cam0_vcamio-supply = <&mt_pmic_vcamio_ldo_reg>;
	cam1_vcama-supply = <&mt_pmic_vcama2_ldo_reg>;
	cam1_vcamio-supply = <&mt_pmic_vcamio_ldo_reg>;
	cam2_vcama-supply = <&mt_pmic_vcama2_ldo_reg>;
	cam2_vcamd-supply = <&mt_pmic_vcamd_ldo_reg>;
	cam2_vcamio-supply = <&mt_pmic_vcamio_ldo_reg>;
        cam3_vcama-supply = <&mt_pmic_vcama2_ldo_reg>;
        cam3_vcamio-supply = <&mt_pmic_vcamio_ldo_reg>;
        cam4_vcama-supply = <&mt_pmic_vcama2_ldo_reg>;
        cam4_vcamio-supply = <&mt_pmic_vcamio_ldo_reg>;

	cam0_enable_sensor = "s5kgm1sp_mipi_raw";
	cam1_enable_sensor = "s5k3p9sp_mipi_raw";
	cam2_enable_sensor = "hi846_mipi_raw2";
	cam3_enable_sensor = "ov02a10_mipi_raw2 gc02m0_mipi_mono1";
	cam4_enable_sensor = "ov02a10_mipi_raw1 gc02m0_mipi_mono";
	status = "okay";
};
#include <oppo6771_19531/cust.dtsi>
//#include "cust_mt6771_camera.dtsi"
#include "mediatek/oppo6771_19531_audio_extend.dtsi"
/*End of this file, DO NOT ADD ANYTHING HERE*/


